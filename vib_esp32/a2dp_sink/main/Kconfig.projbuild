## vib_esp32/a2dp_sink/main/Kconfig.projbuild
```kconfig
menu "A2DP Example Configuration"

    choice EXAMPLE_A2DP_SINK_OUTPUT
        prompt "A2DP Sink Output"
        default EXAMPLE_A2DP_SINK_OUTPUT_EXTERNAL_I2S
        help
            Select to use Internal DAC or external I2S driver

        config EXAMPLE_A2DP_SINK_OUTPUT_INTERNAL_DAC
            bool "Internal DAC"
            help
                Select this to use Internal DAC sink output

        config EXAMPLE_A2DP_SINK_OUTPUT_EXTERNAL_I2S
            bool "External I2S Codec"
            help
                Select this to use External I2S sink output

    endchoice

    config EXAMPLE_I2S_LRCK_PIN
        int "I2S LRCK (WS) GPIO"
        default 4
        depends on EXAMPLE_A2DP_SINK_OUTPUT_EXTERNAL_I2S
        help
            GPIO number to use for I2S LRCK(WS) Driver.

    config EXAMPLE_I2S_BCK_PIN
        int "I2S BCK GPIO"
        default 17
        depends on EXAMPLE_A2DP_SINK_OUTPUT_EXTERNAL_I2S
        help
            GPIO number to use for I2S BCK Driver.

    config EXAMPLE_I2S_DATA_PIN
        int "I2S DATA GPIO"
        default 16
        depends on EXAMPLE_A2DP_SINK_OUTPUT_EXTERNAL_I2S
        help
            GPIO number to use for I2S Data Driver.
    
    config EXAMPLE_ENABLE_GPIO
        int "POWER MODULE ENABLE GPIO"
        default 13
        help
            GPIO number to enable power module
        
    config EXAMPLE_LEDC_OUT
        int "POWER MODULE PWM OUTPUT"
        default 12
        help
            GPIO number to the power module FREQ input
        
    config EXAMPLE_LEDC_DUTY
        int "POWER MODULE PWM DUTY"
        default 4095
        help
            Duty of power module PWM (default is 4095; 50%)

endmenu
```
